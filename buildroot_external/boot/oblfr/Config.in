## buildroot_external/boot/oblfr/Config.in
```kconfig
config BR2_TARGET_OBLFR
	bool "oblfr"
	select host-blmcusdk
	select host-python3
	help
	  OpenBouffalo Low Level Boot Loaders

	  https://github.com/openbouffalo/OBLFR
```

## buildroot_external/configs/zynq_rk7020f_ad_defconfig
```kconfig
BR2_arm=y
BR2_cortex_a9=y
BR2_ARM_ENABLE_NEON=y
BR2_ARM_ENABLE_VFP=y
BR2_TOOLCHAIN_EXTERNAL=y
BR2_TOOLCHAIN_EXTERNAL_BOOTLIN=y
BR2_TOOLCHAIN_EXTERNAL_BOOTLIN_ARMV7_EABIHF_GLIBC_STABLE=y
BR2_GLOBAL_PATCH_DIR="$(BR2_EXTERNAL_FKA_PATH)/board/zynq/RK-ZYNQ7020-F-AD/patches"
BR2_TARGET_GENERIC_ROOT_PASSWD="hello"
BR2_ROOTFS_OVERLAY="$(BR2_EXTERNAL_FKA_PATH)/board/zynq/RK-ZYNQ7020-F-AD/rootfs_overlay"
BR2_ROOTFS_POST_BUILD_SCRIPT="board/zynq/post-build.sh"
BR2_ROOTFS_POST_IMAGE_SCRIPT="$(BR2_EXTERNAL_FKA_PATH)/board/zynq/RK-ZYNQ7020-F-AD/post-image.sh"
BR2_LINUX_KERNEL=y
BR2_LINUX_KERNEL_CUSTOM_GIT=y
BR2_LINUX_KERNEL_CUSTOM_REPO_URL="https://github.com/analogdevicesinc/linux.git"
BR2_LINUX_KERNEL_CUSTOM_REPO_VERSION="2026_R1"
BR2_LINUX_KERNEL_DEFCONFIG="xilinx_zynq"
BR2_LINUX_KERNEL_CONFIG_FRAGMENT_FILES="$(BR2_EXTERNAL_FKA_PATH)/board/zynq/RK-ZYNQ7020-F-AD/linux-config.fragment"
BR2_LINUX_KERNEL_UIMAGE=y
BR2_LINUX_KERNEL_UIMAGE_LOADADDR="0x8000"
BR2_LINUX_KERNEL_DTS_SUPPORT=y
BR2_LINUX_KERNEL_INTREE_DTS_NAME="xilinx/zynq-rk7020f-ad"
BR2_LINUX_KERNEL_CUSTOM_DTS_DIR="$(BUILD_DIR)/zynq-dtgen/output"
BR2_LINUX_KERNEL_DTB_OVERLAY_SUPPORT=y
BR2_LINUX_KERNEL_NEEDS_HOST_OPENSSL=y
# zynq-dtgen: root dts (PS side: zynq-7000.dtsi/pcw.dtsi) generated from the
# .xsa below via xsct; falls back to the committed dts in FALLBACK_DIR (see
# its SOURCE.txt in the build dir) if xsct/the .xsa aren't available. The
# AD9361/FMCOMMS2 PL fabric + RF tuning stay hand-written in
# dts/xilinx/zynq-rk7020f-ad-fixup.dtsi - see the help text on
# BR2_PACKAGE_HOST_ZYNQ_DTGEN for why that part isn't auto-generated.
BR2_PACKAGE_HOST_ZYNQ_DTGEN=y
BR2_PACKAGE_HOST_ZYNQ_DTGEN_DTS_NAME="zynq-rk7020f-ad"
BR2_PACKAGE_HOST_ZYNQ_DTGEN_XSA_PATH="/home/fka/dev_fpga/hdl/projects/fmcomms2/rk_zynq7020f/fmcomms2_rk_zynq7020f.sdk/system_top.xsa"
BR2_PACKAGE_HOST_ZYNQ_DTGEN_FALLBACK_DIR="$(BR2_EXTERNAL_FKA_PATH)/board/zynq/RK-ZYNQ7020-F-AD/dts/xilinx"
BR2_PACKAGE_BUSYBOX_SHOW_OTHERS=y
BR2_PACKAGE_GZIP=y
BR2_PACKAGE_GDB=y
BR2_PACKAGE_GDB_SERVER=y
BR2_PACKAGE_GDB_DEBUGGER=y
BR2_PACKAGE_LTRACE=y
BR2_PACKAGE_MEMSTAT=y
BR2_PACKAGE_SPIDEV_TEST=y
BR2_PACKAGE_VALGRIND=y
BR2_PACKAGE_FINDUTILS=y
BR2_PACKAGE_GREP=y
BR2_PACKAGE_XILINX_FPGAUTIL=y
BR2_PACKAGE_SYSSTAT=y
BR2_PACKAGE_DHCPCD=y
BR2_PACKAGE_ETHTOOL=y
BR2_PACKAGE_IPROUTE2=y
BR2_PACKAGE_OPENSSH=y
BR2_PACKAGE_TCPDUMP=y
BR2_PACKAGE_WGET=y
BR2_PACKAGE_BASH=y
BR2_PACKAGE_COREUTILS=y
BR2_PACKAGE_HTOP=y
BR2_PACKAGE_TAR=y
BR2_PACKAGE_UTIL_LINUX=y
BR2_PACKAGE_UTIL_LINUX_BINARIES=y
BR2_PACKAGE_NANO=y
BR2_PACKAGE_VIM=y
BR2_PACKAGE_LIBIIO=y
BR2_PACKAGE_LIBIIO_TESTS=y
BR2_TARGET_ROOTFS_CPIO=y
BR2_TARGET_ROOTFS_CPIO_GZIP=y
BR2_TARGET_ROOTFS_EXT2=y
BR2_TARGET_ROOTFS_EXT2_4=y
BR2_TARGET_ROOTFS_EXT2_SIZE="256M"
BR2_TARGET_UBOOT=y
BR2_TARGET_UBOOT_BUILD_SYSTEM_KCONFIG=y
BR2_TARGET_UBOOT_CUSTOM_TARBALL=y
BR2_TARGET_UBOOT_CUSTOM_TARBALL_LOCATION="$(call github,Xilinx,u-boot-xlnx,xlnx_rebase_v2025.01_2025.1)/xlnx_rebase_v2025.01_2025.1.tar.gz"
BR2_TARGET_UBOOT_BOARD_DEFCONFIG="xilinx_zynq_virt"
BR2_TARGET_UBOOT_CONFIG_FRAGMENT_FILES="$(BR2_EXTERNAL_FKA_PATH)/board/zynq/RK-ZYNQ7020-F-AD/uboot-config.fragment"
BR2_TARGET_UBOOT_NEEDS_DTC=y
BR2_TARGET_UBOOT_NEEDS_OPENSSL=y
BR2_TARGET_UBOOT_FORMAT_REMAKE_ELF=y
BR2_TARGET_UBOOT_FORMAT_IMG=y
BR2_TARGET_UBOOT_SPL=y
BR2_TARGET_UBOOT_SPL_NAME="spl/boot.bin"
BR2_TARGET_UBOOT_ZYNQ=y
BR2_TARGET_UBOOT_ZYNQ_PS7_INIT_FILE="$(BR2_EXTERNAL_FKA_PATH)/board/zynq/RK-ZYNQ7020-F-AD/ps7_init/ps7_init_gpl.c"
BR2_TARGET_UBOOT_CUSTOM_DTS_PATH="$(BUILD_DIR)/zynq-dtgen/output/xilinx/zynq-rk7020f-ad.dts $(BUILD_DIR)/zynq-dtgen/output/xilinx/zynq-7000.dtsi $(BUILD_DIR)/zynq-dtgen/output/xilinx/pcw.dtsi $(BUILD_DIR)/zynq-dtgen/output/xilinx/zynq-rk7020f-ad-fixup.dtsi"
BR2_TARGET_UBOOT_CUSTOM_MAKEOPTS="DEVICE_TREE=zynq-rk7020f-ad"
BR2_PACKAGE_HOST_CMAKE=y
BR2_PACKAGE_HOST_DOSFSTOOLS=y
BR2_PACKAGE_HOST_GENIMAGE=y
BR2_PACKAGE_HOST_MTOOLS=y
# BR2_TARGET_OBLFR is not set
# BR2_PACKAGE_BLMCUSDK is not set
# BR2_PACKAGE_MERGEBIN is not set
```

## buildroot_external/package/Config.in
```kconfig
source "$BR2_EXTERNAL_FKA_PATH/package/aerolith/Config.in"
source "$BR2_EXTERNAL_FKA_PATH/package/cloudutils/Config.in"
source "$BR2_EXTERNAL_FKA_PATH/package/blwnet_xram/Config.in"
source "$BR2_EXTERNAL_FKA_PATH/package/i2c-bl808/Config.in"
source "$BR2_EXTERNAL_FKA_PATH/package/xvc-server/Config.in"
source "$BR2_EXTERNAL_FKA_PATH/package/xvc-uio/Config.in"
source "$BR2_EXTERNAL_FKA_PATH/package/xvc-driver/Config.in"
```

## buildroot_external/package/aerolith/Config.in
```kconfig
config BR2_PACKAGE_AEROLITH
	bool "aerolith"
	select BR2_PACKAGE_PYTHON3
	depends on BR2_LINUX_KERNEL
	help
	  Reads a Sensirion SCD41 (CO2/temperature/humidity) over the
	  kernel's scd4x IIO sysfs interface and renders the readings on
	  the Sipeed M1s's onboard MIPI-DBI display (/dev/fb0). Pure
	  Python 3 stdlib, no extra libraries needed.

	  Installs an /etc/init.d/S99aerolith script to start it at boot.

	  https://github.com/FernandesKA/aerolith
```

## buildroot_external/package/blmcusdk/Config.in.host
```kconfig
config BR2_PACKAGE_BLMCUSDK
    bool "host-blmcusdk"
    select BR2_PACKAGE_HOST_CMAKE
    select BR2_PACKAGE_HOST_MAKE
    help
      bl_mcu_sdk is the Bouffalo MCU SDK
```

## buildroot_external/package/xvc-driver/Config.in
```kconfig
comment "xvc-driver needs a Linux kernel to be built"
	depends on !BR2_LINUX_KERNEL

config BR2_PACKAGE_XVC_DRIVER
	bool "xvc-driver"
	depends on BR2_LINUX_KERNEL
	help
	  Xilinx Virtual Cable (XVC) ioctl kernel driver
	  (xilinx_xvc_driver.ko).

	  Maps the memory of one or more "debug_bridge" AXI
	  JTAG-to-BSCAN IP cores from the programmable logic and exposes
	  them to user space as /dev/xilinx_xvc_driver* character
	  devices, accessed via ioctl(). This is the method Xilinx
	  recommends over the legacy UIO mmap approach (see xvc-uio).

	  To bind, the target "debug_bridge" node(s) in your device tree
	  must have "compatible = \"xlnx,xvc\";" (see xvc_fragment.dts
	  and xvc_user_config_example.h in the package sources for how to
	  target a non-default compatible string or multiple bridges).
	  This depends on the actual PL bitstream/address map for your
	  board and is not provided by this package.

	  Pairs with the xvc-server package (xvcServer_ioctl).

	  https://github.com/Xilinx/XilinxVirtualCable/tree/master/jtag/zynqMP/src/driver
```

## buildroot_external/package/xvc-server/Config.in
```kconfig
config BR2_PACKAGE_XVC_SERVER
	bool "xvc-server"
	help
	  Xilinx Virtual Cable (XVC) server for Linux.

	  XVC is a TCP/IP protocol (default port 2542) that lets Vivado's
	  Hardware Manager / Lab tools drive JTAG on an FPGA over the
	  network exactly as if a physical JTAG cable were attached,
	  by talking to a "debug_bridge" AXI JTAG-to-BSCAN IP core in the
	  programmable logic.

	  This installs two userspace binaries built from the same
	  xvcServer.c (XAPP1251 / Zynq UltraScale+ derivative):

	    - /usr/bin/xvcServer_ioctl
	        Talks to /dev/xilinx_xvc_driver* via ioctl().
	        Requires the xvc-driver kernel module to be loaded and
	        bound to a "xlnx,xvc" device tree node.

	    - /usr/bin/xvcServer_mmap
	        Talks to /dev/uioN via mmap(), using the kernel's generic
	        UIO framework. Requires xvc-uio (or any equivalent UIO
	        binding) and a matching "generic-uio" device tree node.

	  https://github.com/Xilinx/XilinxVirtualCable
```

## buildroot_external/package/xvc-uio/Config.in
```kconfig
comment "xvc-uio needs a Linux kernel to be built"
	depends on !BR2_LINUX_KERNEL

config BR2_PACKAGE_XVC_UIO
	bool "xvc-uio"
	depends on BR2_LINUX_KERNEL
	help
	  Enables the Linux kernel's generic UIO framework (CONFIG_UIO,
	  CONFIG_UIO_PDRV_GENIRQ) used by the legacy mmap-based Xilinx
	  Virtual Cable (XVC) access method.

	  This is the "generic_uio" path documented by Xilinx as a
	  legacy alternative to the ioctl-based xvc-driver: a
	  "debug_bridge" AXI JTAG-to-BSCAN IP core is bound to a UIO
	  device instead of a dedicated character device, and user space
	  (xvcServer_mmap from xvc-server) mmap()s /dev/uioN directly.

	  No custom driver code ships in this package; it is a thin
	  kernel-config enabler. To actually bind a PL IP core to UIO
	  you still need a matching device tree node, e.g.:

	    debug_bridge_0 {
	        compatible = "generic-uio";
	        ...
	    };

	  which depends on your board's PL bitstream/address map and is
	  not provided here.

	  Pairs with the xvc-server package (xvcServer_mmap).
```

## buildroot_external/package/zynq-dtgen/Config.in.host
```kconfig
config BR2_PACKAGE_HOST_ZYNQ_DTGEN
	bool "zynq-dtgen (generate Zynq/ZynqMP DTS from a Xilinx .xsa)"
	help
	  Generates a Zynq/ZynqMP root device tree (PS side) and a
	  separate PL devicetree overlay straight from a Vivado .xsa
	  hardware export, using Xilinx's xsct tool and the
	  device-tree-xlnx generator (github.com/Xilinx/device-tree-xlnx).

	  Output lands in $(BUILD_DIR)/zynq-dtgen/output/xilinx/ as:
	    <dts name>.dts                 root/PS devicetree
	    zynq-7000.dtsi / pcw.dtsi      (or zynqmp.dtsi) included by it
	    <dts name>-pl.dtso             PL fabric, as an overlay

	  Point BR2_LINUX_KERNEL_CUSTOM_DTS_DIR / BR2_TARGET_UBOOT_CUSTOM_DTS_PATH
	  at that output directory to actually use it.

	  If xsct can't be found, the .xsa is missing, or generation fails
	  for any other reason, the directory in
	  BR2_PACKAGE_HOST_ZYNQ_DTGEN_FALLBACK_DIR is copied in its place
	  instead, so the build never fails for lack of Xilinx tools -
	  a SOURCE.txt marker is dropped in the output dir either way,
	  saying whether it was generated or copied from the fallback.

if BR2_PACKAGE_HOST_ZYNQ_DTGEN

config BR2_PACKAGE_HOST_ZYNQ_DTGEN_DTS_NAME
	string "Output DTS base name"
	help
	  Base name (no extension) of the generated root DTS and PL
	  overlay, e.g. "zynq-rk7020f-ad" produces zynq-rk7020f-ad.dts
	  and zynq-rk7020f-ad-pl.dtso.

config BR2_PACKAGE_HOST_ZYNQ_DTGEN_XSA_PATH
	string "Path to .xsa hardware export"
	help
	  Absolute path to the Vivado-exported .xsa (e.g. system_top.xsa)
	  describing this board's PS configuration and PL IP.

	  Left empty, or pointing at a file that doesn't exist, triggers
	  the fallback below instead of failing the build.

config BR2_PACKAGE_HOST_ZYNQ_DTGEN_XSCT
	string "xsct binary"
	default "xsct"
	help
	  Path to (or name in PATH of) Xilinx's xsct tool, part of a
	  Vitis/Vivado install. Not found also triggers the fallback.

config BR2_PACKAGE_HOST_ZYNQ_DTGEN_FALLBACK_DIR
	string "Fallback dts directory"
	help
	  Directory with an already-committed root dts/dtsi for this
	  board (same layout as an arch/.../boot/dts/xilinx dts dir).
	  Copied verbatim into the generator's output whenever xsct/.xsa
	  based generation cannot run - this is what keeps the build
	  working on machines without Xilinx tools installed.

	  Also where an optional "<dts name>-fixup.dtsi" is looked up:
	  when present, it's #include-d at the end of the generated root
	  dts (and copied alongside it) so board-specific manual fixes
	  survive re-generation.

config BR2_PACKAGE_HOST_ZYNQ_DTGEN_DEVICE_TREE_XLNX_VERSION
	string "device-tree-xlnx git branch/tag"
	default "xilinx_v2025.1"
	help
	  git branch/tag of https://github.com/Xilinx/device-tree-xlnx to
	  check out; should match the Vivado/Vitis version that produced
	  the .xsa.

endif
```
