/*
 * CAUTION: This file is automatically generated by Xilinx.
 * Version: XSCT 2025.1
 * Today is: Fri May 15 21:57:52 2026
 */


/dts-v1/;
#include "zynq-7000.dtsi"
#include "pcw.dtsi"
/ {
	chosen {
		bootargs = "earlycon";
		stdout-path = "serial0:115200n8";
	};
	aliases {
		ethernet0 = &gem0;
		serial0 = &uart0;
	};
	memory@0 {
		device_type = "memory";
		reg = <0x0 0x40000000>;
	};
};
